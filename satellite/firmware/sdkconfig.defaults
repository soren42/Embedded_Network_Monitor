## satellite/firmware/sdkconfig.defaults
```kconfig
# ESP32-S3 target
CONFIG_IDF_TARGET="esp32s3"

# USB CDC for serial communication with host
CONFIG_TINYUSB_CDC_ENABLED=y
CONFIG_TINYUSB_CDC_RX_BUFSIZE=512
CONFIG_TINYUSB_CDC_TX_BUFSIZE=512

# Flash size (16MB for Waveshare boards)
CONFIG_ESPTOOLPY_FLASHSIZE_16MB=y
CONFIG_ESPTOOLPY_FLASHSIZE="16MB"

# PSRAM (8MB OPI on 1.85C/1.46B, 2MB on 1.28)
CONFIG_SPIRAM=y
CONFIG_SPIRAM_MODE_OCT=y
CONFIG_SPIRAM_SPEED_80M=y

# CPU frequency
CONFIG_ESP_DEFAULT_CPU_FREQ_MHZ_240=y

# Partition table
CONFIG_PARTITION_TABLE_CUSTOM=y
CONFIG_PARTITION_TABLE_CUSTOM_FILENAME="partitions.csv"

# Task watchdog - increase for LVGL
CONFIG_ESP_TASK_WDT_TIMEOUT_S=10

# Logging
CONFIG_LOG_DEFAULT_LEVEL_INFO=y

# Use internal USB PHY (ESP32-S3 native USB)
CONFIG_USB_OTG_SUPPORTED=y

# LVGL fonts
CONFIG_LV_FONT_MONTSERRAT_10=y
CONFIG_LV_FONT_MONTSERRAT_12=y
CONFIG_LV_FONT_MONTSERRAT_14=y
CONFIG_LV_FONT_MONTSERRAT_16=y

# LVGL widgets
CONFIG_LV_USE_ARC=y
CONFIG_LV_USE_LABEL=y
CONFIG_LV_USE_LINE=y

# LVGL color
CONFIG_LV_COLOR_DEPTH_16=y
CONFIG_LV_COLOR_16_SWAP=y
```
